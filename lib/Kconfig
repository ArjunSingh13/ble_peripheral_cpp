## lib/Kconfig
```kconfig
menu "Custom Libraries"

rsource "drv_led/Kconfig"
rsource "drv_ble_peripheral/Kconfig"
# rsource "drv_button/Kconfig"

endmenu
```

## lib/drv_ble_peripheral/Kconfig
```kconfig
mainmenu "Project BLE Peripheral"

menu "BLE Advertise"

config ADVERTISE_URL
    string "Your choice of website string"
    default "//arjun.com"
    help
        Your website name.

config ADVERTISE_PREFIX
    int "Prefix to your website"
    default 23
    help
        Prefix for your website (e.g., HTTP default is 23).

config COMPANY_ID_CODE
    int "Nordic's default code"
    default 83
    help
      This is the code that you need to register and get from Bluetooth SIG

config MIN_ADVERTISE_INTERVAL
    int "Minimum interval time value: n * .625 ms"
    default 800
    help
      Set minimum advertise interval

config MAX_ADVERTISE_INTERVAL
    int "Maximum interval time for advertise data: n * .625 ms"
    default 801
    help
      Set maximum advertise interval

config CONNECTABLE_PERIPHERAL
    int "To make Peripheral connectable or not"
    default 1
    help
      Set value to 1 for connectab
endmenu

# Optional logging configuration inclusion (comment out if not needed)
# source "subsys/logging/Kconfig.template.log_config"
```

## lib/drv_button/Kconfig
```kconfig
mainmenu "Project BLE Peripheral"

source "Kconfig.zephyr"

menu "Drive Led"
config DRV_BUTTON
	bool "Enable Led driver"
	default y
	help
	  Enables the push button driver library.

module = DRV_BUTTON
module-str = Button driver
source "subsys/logging/Kconfig.template.log_config"
    
endmenu
```

## lib/drv_led/Kconfig
```kconfig
mainmenu "Project BLE Peripheral"

source "Kconfig.zephyr"

menu "Drive Led"
config DRV_LED
	bool "Enable Led driver"
	default y
	help
	  Enables the Led driver library.

module = DRV_LED
module-str = Led driver
source "subsys/logging/Kconfig.template.log_config"
    
endmenu
```
